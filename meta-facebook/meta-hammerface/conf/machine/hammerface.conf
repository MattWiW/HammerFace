## meta-facebook/meta-hammerface/conf/machine/hammerface.conf
```bitbake
#@TYPE: Machine
#@NAME: HammerFace
#@DESCRIPTION: Machine configuration for HammerFace

UBOOT_MACHINE_hammerface = "hammerface_config"

PREFERRED_VERSION_u-boot = "v2016.07"
PREFERRED_VERSION_u-boot-mkimage = "v2016.07"
PREFERRED_VERSION_u-boot-fw-utils = "v2016.07"

KERNEL_IMAGETYPE = "zImage"

require conf/machine/include/ast2520.inc

# configuration for preferred version of packages
```
